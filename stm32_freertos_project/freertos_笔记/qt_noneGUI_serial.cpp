
#include <QCoreApplication>
#include <QByteArray>
#include <QString>
#include <QTextStream>
#include<QSerialPort>
#include<QSerialPortInfo>
#include<QDebug>
QTextStream cout(stdout);
QTextStream cin(stdin);

void show_menu();
void show_menu_pwm();
void checkpwm_input();
void generate_pwmbuffer();
bool show_port_information();
void init_serialport();
void setPWM(QSerialPort *myserialport);

QString portname;
QByteArray pwm_message;
quint16 TIMx_CH[4]={0},CRC_NUM;
quint16 arr[4]={0};
typedef unsigned short uint16_t;
typedef unsigned char uint8_t;
/* Table of CRC values for highorder byte */
static unsigned char auchCRCHi[] = {
    0x00, 0xC1, 0x81, 0x40, 0x01, 0xC0, 0x80, 0x41, 0x01, 0xC0, 0x80, 0x41, 0x00, 0xC1, 0x81,
    0x40, 0x01, 0xC0, 0x80, 0x41, 0x00, 0xC1, 0x81, 0x40, 0x00, 0xC1, 0x81, 0x40, 0x01, 0xC0,
    0x80, 0x41, 0x01, 0xC0, 0x80, 0x41, 0x00, 0xC1, 0x81, 0x40, 0x00, 0xC1, 0x81, 0x40, 0x01,
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    0x00, 0xC1, 0x81, 0x40, 0x01, 0xC0, 0x80, 0x41, 0x01, 0xC0, 0x80, 0x41, 0x00, 0xC1, 0x81,
    0x40 };
/* Table of CRC values for loworder byte */
static unsigned char auchCRCLo[] = {
    0x00, 0xC0, 0xC1, 0x01, 0xC3, 0x03, 0x02, 0xC2, 0xC6, 0x06, 0x07, 0xC7, 0x05, 0xC5, 0xC4,
    0x04, 0xCC, 0x0C, 0x0D, 0xCD, 0x0F, 0xCF, 0xCE, 0x0E, 0x0A, 0xCA, 0xCB, 0x0B, 0xC9, 0x09,
    0x08, 0xC8, 0xD8, 0x18, 0x19, 0xD9, 0x1B, 0xDB, 0xDA, 0x1A, 0x1E, 0xDE, 0xDF, 0x1F, 0xDD,
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    0x44, 0x84, 0x85, 0x45, 0x87, 0x47, 0x46, 0x86, 0x82, 0x42, 0x43, 0x83, 0x41, 0x81, 0x80,
    0x40 };
/*
 * Compute CRC-16
 */
static uint16_t crc16(QByteArray buffer, uint16_t buffer_length)
{
    uint8_t crc_hi = 0xFF; /* high CRC byte initialized */
    uint8_t crc_lo = 0xFF; /* low CRC byte initialized */
    unsigned int i; /* will index into CRC lookup */
    int index = 0;

    /* pass through message buffer */
    while (buffer_length--) {
        i = crc_hi ^(uint8_t) buffer.at(index++); /* calculate the CRC  */
        crc_hi = crc_lo ^ auchCRCHi[i];
        crc_lo =auchCRCLo[i];
    }
    return (crc_hi << 8 | crc_lo);
}
int main(int argc, char *argv[])
{
    QCoreApplication a(argc, argv);
    if(show_port_information())
    {
        init_serialport();
    }
    return a.exec();
}
void init_serialport()
{
    QSerialPort *serialPort=new QSerialPort;
    quint8 ch;
            do{
                show_menu();
                serialPort->setPortName(portname);
            }while(serialPort->open(QSerialPort::ReadWrite)==false);

            cout<<"sucess open the port"<<endl;//端口
            serialPort->setDataBits(QSerialPort::Data8);//数据位
            serialPort->setBaudRate(9600);//波特率
            serialPort->setParity(QSerialPort::NoParity);//奇偶校验
            serialPort->setStopBits(QSerialPort::OneAndHalfStop);//停止位
            do
            {show_menu_pwm();
            checkpwm_input();
            generate_pwmbuffer();
            setPWM(serialPort);
            ch=getchar();
            }while(ch!='#');
            serialPort->close();
}
bool show_port_information()
{

    if(QSerialPortInfo::availablePorts().size()==0)
       { cout<<"no available com!,please plug in the right com_equipment and restart it!"<<endl;
         return false;

    }
    else{
        cout<<"avalible ports:"<<endl;
    foreach (const QSerialPortInfo &info, QSerialPortInfo::availablePorts())
    {
        cout << "Name: " << info.portName()<<endl;
        cout << "Description : " << info.description()<<endl;
    }

     return true;
    }
}
void show_menu()
{

    cout<<"Now chose the right serialport:"<<endl;
    cin>>portname;
}
void show_menu_pwm()
{

    cout<<"Now you can set the PWM:"<<endl;
    cout<<"PWM1 PWM2 PWM3 PWM4"<<endl;
    cin>>TIMx_CH[0]>>TIMx_CH[1];
    cin>>TIMx_CH[2]>>TIMx_CH[3];

}
void setPWM(QSerialPort *myserialport)
{
    //  qDebug()<<"sendbuffer"<<endl;
    //  qDebug()<<pwm_message.toHex();
     myserialport->write(pwm_message);
     //等一个ACK
     QByteArray readData = myserialport->readAll();
         while (myserialport->waitForReadyRead(500))
             readData.append(myserialport->readAll());

         if (myserialport->error() == QSerialPort::ReadError) {
            cout<<"ReadError"<<endl;

         } else if (myserialport->error() == QSerialPort::TimeoutError && readData.isEmpty()) {

             cout<<" nodate"<<endl;
             cout<<"you may need to reaset the board "<<endl;
         }
         else
         {
            // qDebug()<<readData.toHex();
             cout<<"set pwm success"<<endl;
             cout<<"press enter to contiue or you can close the program "<<endl;
         }
         myserialport->clear();
}
void checkpwm_input()
{
    if(TIMx_CH[0]<500||TIMx_CH[0]>20000||TIMx_CH[1]<500||TIMx_CH[1]>20000||TIMx_CH[2]<500||TIMx_CH[2]>20000||TIMx_CH[3]<500||TIMx_CH[3]>20000)
    {
        cout<<"Please set everychannel between 500 and 200000 (500HZ-20KHZ)"<<endl;
        show_menu_pwm();
    }
}

void generate_pwmbuffer()
{
    pwm_message.clear(); //每次生成前先清该串
    //加一个check_input();
    pwm_message[0]=0xff;
    pwm_message[1]=0xee;

    for(int i=0;i<4;i++)
    {
        arr[i]=8000000/TIMx_CH[i];
        pwm_message.append(arr[i]>>8);
        pwm_message.append(arr[i]);
    }
   //  qDebug()<<pwm_message.size();
     CRC_NUM=crc16(pwm_message,pwm_message.size());
     pwm_message.append(CRC_NUM>>8);
     pwm_message.append(CRC_NUM);
}
